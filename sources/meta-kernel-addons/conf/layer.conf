## sources/meta-kernel-addons/conf/layer.conf
```bitbake
# We have a conf and classes directory, add to BBPATH
BBPATH .= ":${LAYERDIR}"

# We have recipes-* directories, add to BBFILES
BBFILES += "${LAYERDIR}/recipes-*/*/*.bb \
	${LAYERDIR}/recipes-*/*/*.bbappend"

BBFILE_COLLECTIONS += "kernel-addons"
BBFILE_PATTERN_kernel-addons = "^${LAYERDIR}/"
BBFILE_PRIORITY_kernel-addons = "6"
```
